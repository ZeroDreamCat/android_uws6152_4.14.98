## drivers/input/misc/mafp/Kconfig
```kconfig
config FINGERPRINT_MICROARRAY
	tristate "MicroArray fingerprint sensor support"
	depends on SPI
	select INPUT
	select FB
	help
	  This driver supports the MicroArray fingerprint sensor
	  connected via SPI interface.

	  To compile this driver as a module, choose M here: the
	  module will be called madev.
```
